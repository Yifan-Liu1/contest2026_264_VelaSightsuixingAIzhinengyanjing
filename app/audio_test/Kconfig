## app/audio_test/Kconfig
```kconfig
#
# For a description of the syntax of this configuration file,
# see the file kconfig-language.txt in the NuttX tools repository.
#

config LVX_USE_DEMO_CONTEST2026_264_AUDIO_TEST
	bool "BK7258 internal-DAC audio bring-up test"
	default n
	depends on BK7258_AUDIO
	---help---
		Enable the audio_test NSH command: plays a synthesised tone through
		the internal DAC, captures the analog MIC channels, and reports
		per-channel DC/RMS/peak plus the correlation between the microphone
		and the MIC2 post-amplifier echo reference.

		This is a measurement command rather than a player or recorder: the
		AP configuration has no writable filesystem, so there is nowhere to
		store a WAV file.

config AUDIO_TEST_OGG_COMPLEXITY
	int "Opus encoder complexity (0-10)"
	default 0
	range 0 10
	---help---
		Complexity passed to OPUS_SET_COMPLEXITY by the shared Ogg Opus
		encoder in audio_test_ogg.c, which both the audio_test command and
		the VelaSight social session use.

		Deliberately not libopus's own default of 9.  That default assumes
		a host encoding far faster than realtime; this board does not.
		Measured 2026-09-07 during a continuous social session, encoding
		each 2 s chunk took about 3.2 s of dedicated CPU -- the encoder was
		60% short of keeping up with the microphone, and 45% of the
		conversation was lost to the capture ring overflowing while it
		worked.

		0 is the cheapest setting and typically several times faster than
		9.  What it gives up is rate-distortion efficiency, which matters
		least in this application: 16 kHz mono speech at 24 kbps on its way
		to a recogniser, where the alternative is missing half of it.

		Raise it only after measuring that the encoder keeps ahead of the
		microphone -- the "microphone: ... N bytes dropped" line at the end
		of a session is the test.
```

## app/conv/Kconfig
```kconfig
#
# For a description of the syntax of this configuration file,
# see the file kconfig-language.txt in the NuttX tools repository.
#

config LVX_USE_DEMO_CONTEST2026_264_CONV
	bool "VelaSight conversation history on SD-NAND"
	default n
	depends on FS_FAT
	---help---
		Enable the conv NSH command: stores conversation records on the
		SD-NAND and answers the web console's history queries locally.

		Each record is a transcript, a social-cue/v1 analysis of the other
		person's expression, and the recording.  Queries filter by date
		range, cue and confidence from a single index file, then search the
		transcripts of only the records that survived that filter, and the
		matches are POSTed to the console with their recordings.

		The query runs on the board because the recordings are on the board:
		shipping every conversation to the console so it could filter them
		would move megabytes to answer a question whose answer is a few
		hundred bytes, over the same link that carries live audio.

		Note that this board cannot timestamp its own records -- time(NULL)
		returns seconds since boot -- so dates are supplied from outside and
		stored in the index.  Neither filenames nor mtimes can hold them:
		FAT_LFN is off, so names are 8.3, and FS_FATTIME is off, so the
		filesystem keeps no modification times.
```

## app/netbench/Kconfig
```kconfig
#
# For a description of the syntax of this configuration file,
# see the file kconfig-language.txt in the NuttX tools repository.
#
config LVX_USE_DEMO_CONTEST2026_264_NETBENCH
	bool "BK7258 network benchmark with mailbox counters"
	default n
	depends on NET_TCP && BK7258_WIFI
	---help---
		Enable the netbench NSH command: moves bytes over loopback, TCP,
		UDP or plain HTTP and reports the throughput together with the
		inter-core mailbox counters taken either side of the transfer.
		The AP core owns no radio, so every frame crosses the mailbox to
		the CP.  That makes "the transfer was slow" and "the mailbox was
		why" separate claims, and separating them needs the transport's
		own timeout, FIFO and batching counts rather than an inference
		from the byte rate.  The loopback mode is the control: it stays
		inside the stack, so whatever it reports is the ceiling the
		software imposes without any mailbox or radio involved.
		Nothing is printed until a run finishes, because the console is
		itself a mailbox channel and progress output would add traffic
		to the transport under measurement.
```

## app/provisioning_web/Kconfig
```kconfig
#
# For a description of the syntax of this configuration file,
# see the file kconfig-language.txt in the NuttX tools repository.
#

config LVX_USE_DEMO_CONTEST2026_264_PROVISION_WEB
	bool "AP-mode provisioning web entry"
	default n
	depends on NET_TCP && NET_TCPBACKLOG
	---help---
		A minimal HTTP server that serves one form, accepts an SSID and a
		passphrase, and writes them to persistent storage.  Meant to be
		started by the application through
		velasight_provisioning_start() once the radio is already in
		SoftAP; it never changes the Wi-Fi role itself, so the
		application stays in control of when the network may drop.

		NET_TCPBACKLOG is required, not merely nice to have.  Without it
		NuttX reports no poll event for a pending connection on a
		listening socket (TCP_BACKLOG is the only source of POLLIN
		there), and accept() blocks with no timeout, so a listener that
		can still be stopped is impossible.  The observed symptom of
		building without it is a service that reports "listening" and
		then never answers a request.

		The provision_web command is the manual front end for bringing
		it up over the console.

		The page is plain HTTP with no authentication, which is the usual
		trade-off for a provisioning page on an access point.  Run it
		only while provisioning.

if LVX_USE_DEMO_CONTEST2026_264_PROVISION_WEB

config VELASIGHT_PROVISION_STORE
	string "Provisioning record path"
	default "/mnt/sdnand/prov/wifi.bin"
	---help---
		Where the credential record is written.  The default is on
		SD-NAND because that is the only persistent filesystem: /mnt is
		pseudo-filesystem and /mnt/ram is a PSRAM ramdisk.  The parent
		directory is created on demand.

		Every path component must fit 8.3.  That SD-NAND is VFAT without
		long-name support (CONFIG_FAT_LFN is not set), which rejects a
		"velasight" directory or a "wifi-provision.bin" file with
		-EINVAL rather than shortening it.

		The passphrase is stored in the clear: VFAT has no permission
		model to rely on and this part has no confirmed device key.  It
		is never logged and never echoed back over HTTP, but physical
		access to the SD-NAND reveals it.

config VELASIGHT_PROVISION_PORT
	int "Provisioning HTTP port"
	default 80
	range 1 65535
	---help---
		The port used when the caller passes 0.  80 means a phone can
		open http://<board-ip>/ with no port in the URL.

comment "Social-session cloud factory default"

config VELASIGHT_PROVISION_CLOUD_HOST
	string "Default social cloud host"
	default "staging-hlth.xiaomiwear.com"
	---help---
		The endpoint a device with nothing provisioned talks to, and the
		grey placeholder the setup page shows in the address box.  A
		hostname or dotted quad, with no scheme, no port and no path --
		all three of those are separate.

		The default is the deployment named in the cloud interface
		document.  Note what reaching it requires: the name resolves only
		on the internal network, so a board using the default also needs
		a resolver that can see it.  A dotted quad is not a workaround --
		the deployment routes on the Host header and answers a request
		carrying a bare address with 403.

		Change this to point a build at a local mock instead.  The stored
		record overrides it either way, so this is the fallback, not the
		policy.

config VELASIGHT_PROVISION_CLOUD_PATH
	string "Default social cloud path prefix"
	default "/hlthopen/public"
	---help---
		What sits in front of /contest/v1 on the default host.  Must
		start with '/' and must not end with one; empty means the
		interface is at the document root.

		This is not cosmetic.  The interface document's worked examples
		are written against 127.0.0.1:18080/contest/v1, while the
		deployment answers at /hlthopen/public/contest/v1 and returns an
		empty 204 for the unprefixed path -- which the device would then
		report as a protocol error, sending whoever reads the log after a
		JSON parser bug that does not exist.

config VELASIGHT_PROVISION_CLOUD_PORT
	int "Default social cloud port"
	default 80
	range 1 65535
	---help---
		The port used when the stored record carries none.  80 matches
		the cleartext scheme the interface document specifies for the
		device-facing endpoints.

endif
```

## app/social_cue/Kconfig
```kconfig
#
# For a description of the syntax of this configuration file,
# see the file kconfig-language.txt in the NuttX tools repository.
#

config LVX_USE_DEMO_CONTEST2026_264_SOCIAL_CUE
	bool "VelaSight social-cue state machine (mock closed loop)"
	default n
	---help---
		Enable the social_cue NSH command: runs the表情线索 flow
		idle -> capturing -> analyzing -> notifying -> cancelled with a real
		camera frame and a mocked cloud response.

		This is the week-4 deliverable and the documented fallback for a
		board whose network is not up yet: the Agent state flow and the
		confidence policy can be demonstrated, and every refusal branch
		(low confidence, no face, conflicting cues) can be triggered on
		demand with 'social_cue case <n>' instead of waited for.

		It also carries the skill document: 'social_cue install' writes
		social-cue-assistant.md into the agent's skills directory, which is
		the only way to get a file onto this board.
```

## app/web_tool/Kconfig
```kconfig
#
# For a description of the syntax of this configuration file,
# see the file kconfig-language.txt in the NuttX tools repository.
#

config LVX_USE_DEMO_CONTEST2026_264_WEB_TOOL
	bool "development-machine web console service"
	default n
	depends on NET_TCP && NETUTILS_CJSON && SYSLOG_REGISTER
	select SYSTEM_POPEN
	---help---
		A TCP service the development machine's browser talks to through
		host/console.py: read and write kvdb, configure Wi-Fi, start apps,
		stream the syslog, stream JPEG frames from /dev/video0.

		It replaces the "type a serial command, then run b64frames.py on
		the transcript" loop.  Nothing about HTTP lives on the board: the
		page and the WebSocket are the development machine's job, so the
		page can be edited and reloaded without reflashing.

		Access control is the kvdb key 'web.allow' -- one IPv4 address or
		CIDR block, or several separated by commas.  With that key unset
		the service does not listen at all, so the first setup has to go
		through the serial console once.  A permissive default would make
		the whitelist decoration and would allow the state where someone
		believes it is in force while the board is open to the subnet.

		Needs CONFIG_SYSLOG_MAX_CHANNELS >= 2: the log stream is a second
		syslog channel, and registering one with a single slot replaces
		the console channel, which is the boot log and the rescue path.
		The build fails rather than let that happen silently.

if LVX_USE_DEMO_CONTEST2026_264_WEB_TOOL

config LVX_USE_DEMO_CONTEST2026_264_WEB_TOOL_PORT
	int "TCP port"
	default 8888
	---help---
		The port web_tool listens on.  8888 was checked against the
		ports the CP-side firmware already uses.  Change it here and in
		host/console.py together.

endif # LVX_USE_DEMO_CONTEST2026_264_WEB_TOOL
```

## board/beken/boards/bk7258/bk7258-ap/Kconfig
```kconfig
if ARCH_BOARD_CUSTOM

config ARCH_BOARD_BK7258_AP
	bool "BK7258 AP board"
	default y
	select ARCH_HAVE_BUTTONS
	select ARCH_HAVE_LEDS

config BK7258_MB_UART0_CONSOLE
	bool "Use CP UART0 through Mailbox V2 for the AP console"
	default y
	depends on SERIAL
	select BK7258_MBOX_V2
	select OTHER_UART_SERIALDRIVER
	select SERIAL_IFLOWCONTROL
	select SERIAL_IFLOWCONTROL_WATERMARKS

config BK7258_GC9D01_FB
	bool "GC9D01 panel framebuffer (/dev/fb0)"
	default n
	depends on VIDEO_FB
	select FB_UPDATE
	help
		Register the 160x160 RGB565 GC9D01 round panel as /dev/fb0, driven
		over QSPI1.  FB_UPDATE is required, not optional: the panel has its
		own GRAM and is written over a serial bus, so nothing reaches the
		glass until updatearea() pushes the framebuffer.  FB_UPDATE has no
		prompt of its own in drivers/video/Kconfig and can only be enabled
		by a select, which is why this option exists.

config BK7258_POWER_KEY_MOTOR
	bool "Vibrate while the power key is pressed"
	default n
	depends on ARCH_BUTTONS && PWM
	help
		Poll the active-low GPIO12 power key using the Beken 5 ms/6 sample
		debounce timing. Drive the vibration motor at 1 kHz and 70 percent
		duty while the key is held, and stop it when the key is released.

config BK7258_BT_GATT_TEST
	bool "BK7258 Bluetooth GATT acceptance fixture"
	default n
	depends on BK7258_BLUETOOTH && !BK7258_BT_RAW_SELFTEST
	help
		Register a test-only GATT service with read/write and notification
		characteristics. Keep this disabled in production images.

endif
```
