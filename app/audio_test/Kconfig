## board/beken/chips/bk7258/Kconfig
```kconfig
if ARCH_CHIP_CUSTOM

comment "Beken BK7258 Configuration Options"

config ARCH_CHIP_BK7258
	bool "BK7258 AP"
	default y
	select ARCH_CORTEXM33
	select ARCH_HAVE_CUSTOM_VECTORS
	select ARCH_HAVE_FPU
	select ARCH_HAVE_MPU

	# The AP core executes in place from flash at 0x02150000.  CLIDR reads
	# 0x09200003 on this part, i.e. L1 has both an instruction and a data
	# cache, so uncached instruction fetch out of QSPI is not a hardware
	# limit -- it was only ever the absence of these two selects.  Without
	# them CONFIG_ARMV8M_ICACHE cannot be set and a defconfig asking for it
	# is silently dropped.
	select ARMV8M_HAVE_ICACHE
	select ARMV8M_HAVE_DCACHE
	select ARM_HAVE_MPU_UNIFIED
	select ARCH_HAVE_TRUSTZONE
	select ARCH_IDLE_CUSTOM

config BK7258_CPU_FREQ_HZ
	int "CPU1 fixed frequency"
	default 480000000
	help
		CPU1 frequency used by the SysTick lower-half during initial
		bring-up. Runtime DVFS is intentionally unsupported.

config BK7258_MBOX_V2
	bool
	default y

config BK7258_TRNG
	bool "BK7258 hardware TRNG"
	default n
	select ARCH_HAVE_RNG
	help
		Drive the chip's true random number generator: register /dev/random
		from it, and seed the kernel entropy pool with hardware randomness
		at bring-up.

		This is what makes TLS work honestly.  mbedTLS cannot seed its
		CTR_DRBG without an entropy source, and ai_agent reads /dev/urandom
		or /dev/random; the software fallback (CONFIG_CRYPTO_RANDOM_POOL fed
		by interrupt timing alone) is documented by its own Kconfig as
		possibly not cryptographically secure.

		Enable CONFIG_DEV_RANDOM as well to get /dev/random, and keep
		CONFIG_DEV_URANDOM_RANDOM_POOL so that /dev/urandom is the pool --
		which this driver then seeds from hardware.

config BK7258_WIFI
	bool "BK7258 AP Wi-Fi IPC driver"
	default y
	depends on NET
	select DRIVERS_WIRELESS
	select DRIVERS_IEEE80211
	select NETDEV_WIRELESS_IOCTL
	select NETDEV_WIRELESS_HANDLER

config BK7258_WIFI_TX_SLOTS
	int "BK7258 Wi-Fi direct-push TX slots"
	default 8
	range 2 16
	depends on BK7258_WIFI

config BK7258_BLUETOOTH
	bool "BK7258 CP-backed Bluetooth HCI"
	default n
	depends on ARCH_CHIP_BK7258
	depends on BK7258_MBOX_V2
	depends on ALLOW_BSD_COMPONENTS
	depends on NET && NET_BLUETOOTH
	depends on WIRELESS && WIRELESS_BLUETOOTH
	depends on WIRELESS_BLUETOOTH_HOST
	help
		Enable the native NuttX Bluetooth Host using the BLE controller
		running on CPU0/CP over Mailbox V2.

if BK7258_BLUETOOTH

config BK7258_BT_TX_BUFFERS
	int "Bluetooth AP HCI TX buffers"
	default 8
	range 4 32

config BK7258_BT_TX_QUEUE
	int "Bluetooth transport TX queue entries"
	default 16
	range 8 64

config BK7258_BT_RX_QUEUE
	int "Bluetooth transport RX queue entries"
	default 16
	range 8 64

config BK7258_BT_RAW_SELFTEST
	bool "Run raw BK7258 Bluetooth HCI self-test"
	default n
	help
		Initialize only the raw transport and run HCI transport diagnostics.
		Do not register the NuttX Bluetooth Host in this mode.

endif # BK7258_BLUETOOTH

config BK7258_MB_UART0_TXBUFSIZE
	int "Mailbox UART0 transport TX ring size"
	default 8192
	range 1024 32767
	depends on BK7258_MBOX_V2
	help
		AP-owned byte ring. The fixed wire exchange chunk remains 128 bytes.

config BK7258_MB_UART0_RXBUFSIZE
	int "Mailbox UART0 transport RX capacity"
	default 256
	range 256 4096
	depends on BK7258_MBOX_V2

config BK7258_MB_UART0_SERIAL_RXBUFSIZE
	int "Mailbox UART0 NuttX serial RX buffer size"
	default 256
	depends on BK7258_MBOX_V2

config BK7258_MB_UART0_SERIAL_TXBUFSIZE
	int "Mailbox UART0 NuttX serial TX buffer size"
	default 512
	depends on BK7258_MBOX_V2

config BK7258_PSRAM
	bool "BK7258 CP-managed PSRAM"
	default n
	help
		Map the CP-initialized 16 MB PSRAM window for OpenVela. The AP does
		not initialize the PSRAM PHY and this option does not add PSRAM to
		the NuttX system heap.

config BK7258_PSRAM_SIZE
	hex "BK7258 PSRAM capacity"
	default 0x01000000
	depends on BK7258_PSRAM
	help
		Physical PSRAM capacity required by the validated app_ab layout.

config BK7258_PSRAM_REQUIRED
	bool "Require PSRAM before reporting AP ready"
	default n
	depends on BK7258_PSRAM
	help
		Fail board bring-up and suppress the AP ready notification when the
		CP power vote, AP-owned memory probe, or allocators cannot be set up.

config BK7258_PSRAM_KEEP_POWERED
	bool "Keep PSRAM powered while AP runs"
	default y
	depends on BK7258_PSRAM
	help
		Retain the CPU1 PSRAM power vote for the AP lifetime. Dynamic PSRAM
		power-down is not safe until all media and DMA leases are integrated.


config BK7258_AUDIO
	bool "BK7258 internal analog audio (AUD)"
	default n
	select AUDIO
	help
		Drive the chip's internal 16-bit mono DAC and analog MIC ADC. On this
		board the differential AUDLP/AUDLN pair feeds an HT6872 class-D
		amplifier whose CTRL (mute) pin is GPIO50, and there is no I2S codec.
		Asks CP1 for the AUDP power domain and the AUD module clock over the
		PWC mailbox channel.

config BK7258_AUDIO_CAPTURE
	bool "BK7258 audio capture (MIC1 + AEC reference)"
	default n
	depends on BK7258_AUDIO
	help
		Enable the ADC path. MIC1 (MICP1/MICN1) is the electret microphone.
		When BK7258_AUDIO_AEC_REFERENCE is also set, MIC2 (MICP2/MICN2) is
		enabled as well and carries the post-amplifier speaker feedback, so
		captured frames are L/R interleaved with L = voice and R = echo
		reference.

config BK7258_AUDIO_AEC_REFERENCE
	bool "Capture the MIC2 hardware echo reference"
	default n
	depends on BK7258_AUDIO_CAPTURE
	help
		The schematic taps HT6872 OUT+/OUT- through R84/R83 (39K) and
		C61/C60 (1uF) into MIC2P/MIC2N so that AEC can have a hardware echo
		reference, and ana_reg27 does have a full micen field for MIC2.

		This defaults to n because the reference cannot actually be read on
		BK7258: measured on hardware, the ADC delivers a single channel and
		the upper half of every AUD_ADC_FIFO_PORT word stays zero. With a
		tone audibly playing and MIC1 picking it up acoustically (RMS rising
		from 25.7 to 36.4), MIC2 still returned exactly zero across 15872
		samples. That matches the vendor HAL, where sys_hal_aud_mic2_en()
		and sys_hal_aud_dacr_en() are both explicit "//not support" stubs
		for this SoC: the register fields exist, the datapath does not.

		Enabling this only costs half of every capture buffer to zeros. Use
		a software AEC reference instead -- feed aec_proc() the same PCM
		that was queued to the DAC, which is cleaner anyway (no analog
		noise, no divider tolerance) and needs only a fixed delay
		compensation for the DAC and amplifier.

config BK7258_AUDIO_SAMPLERATE
	int "Default audio sample rate"
	default 16000
	depends on BK7258_AUDIO
	help
		Used when the application does not configure a rate explicitly. Only
		8000, 16000 and 32000 are currently reachable: the driver runs the
		audio block from the 26 MHz crystal, and the 44100/48000 families
		additionally require the APLL calibration sequence, which has not
		been ported yet.

config BK7258_AUDIO_PA_MUTE_GPIO
	int "External amplifier mute GPIO"
	default 50
	depends on BK7258_AUDIO
	help
		BK7258 GPIO driving net MUTE, which reaches the HT6872 CTRL pin
		through R70 (1K). R71 (10K) pulls it low, so the amplifier is muted
		until software drives this pin high. Per the board schematic
		(AIDK_AI玩具开发板_原理图.pdf) MUTE is P50.

config BK7258_AUDIO_PA_ON_DELAY_MS
	int "Delay between DAC enable and amplifier un-mute"
	default 20
	depends on BK7258_AUDIO
	help
		Mirrors onboard_speaker_stream's pa_on_delay: the DAC is started,
		this delay elapses, then the amplifier is un-muted. Keeps the
		amplifier off while the analog output settles so there is no pop.

config BK7258_AUDIO_PA_OFF_DELAY_MS
	int "Delay between DAC mute and amplifier shutdown"
	default 10
	depends on BK7258_AUDIO
	help
		Mirrors onboard_speaker_stream's pa_off_delay. Note the vendor's
		header comment and its code disagree on where this delay sits; the
		code order (mute, delay, amplifier off, DAC teardown) is the one that
		actually suppresses the pop and is what this driver implements.

config BK7258_JPEG_ENC
	bool "BK7258 V4L2 M2M JPEG encoder (software)"
	default n
	depends on VIDEO && DRIVERS_VIDEO
	select LIB_JPEG_TURBO
	select BK7258_PSRAM
	select SCHED_HPWORK
	help
		Register a V4L2 M2M codec that takes raw YUV on the OUTPUT queue and
		produces JPEG on the CAPTURE queue.

		This is a software encoder built on libjpeg-turbo. The chip's hardware
		JPEG block is fed by the DVP camera interface and cannot read pixels
		from memory, so it cannot back a memory-to-memory codec; that block
		belongs to the capture driver instead.

		Buffers are allocated from PSRAM, since one 640x480 frame exceeds the
		AP's entire malloc heap.

if BK7258_JPEG_ENC

config BK7258_JPEG_ENC_DEV_PATH
	string "Device node"
	default "/dev/video1"
	help
		Kept off /dev/video0 so the camera capture driver can own that node.

config BK7258_JPEG_ENC_QUALITY
	int "Default JPEG quality (1-100)"
	default 80
	range 1 100
	help
		Applications can override this at runtime with
		V4L2_CID_JPEG_COMPRESSION_QUALITY.

endif

endif
```

## external/bk_avdk_smp/cp/components/controller_if/Kconfig
```kconfig
menu "Controller IF"
	config CTRL_IF_TP
		bool "Controller Interface Throughput debug"
		default n
	config CONTROLLER_RX_DIRECT_PSH
		bool "Controller RX Buf Directly push to AP"
		default y
	config WIFI_VNET_AP_IPV4
		bool "Application core owns VNET IPv4"
		depends on WIFI_VNET_CONTROLLER && CONTROLLER_RX_DIRECT_PSH
		default n
		help
		  Forward STA ARP and IPv4 traffic to the application core. The
		  controller retains radio, association, security and EAPOL handling.
	config WIFI_VNET_OPENVELA_SOFTAP_IPV4
		bool "OpenVela owns SoftAP VNET IPv4"
		depends on WIFI_VNET_CONTROLLER && CONTROLLER_RX_DIRECT_PSH
		default n
		help
		  Forward ordinary SoftAP ARP and IPv4 traffic to the application
		  core. EAPOL, hostapd, radio and station association remain on the
		  controller core.
	config CONTROLLER_WAR
		bool "Controller RX Buf Directly push to AP"
		default y
	config CONTROLLER_DEBUG
		bool "Controller Debug"
		default n
	config CONTROLLER_AP_BUFFER_COPY
		bool "Controller AP buffer copy to CP buffer when AP use PSRAM instead of SRAM"
		default n
endmenu
```
